## configs/rutoken_4990_rpi2_defconfig
```kconfig
BR2_arm=y
BR2_cortex_a7=y
BR2_ARM_FPU_NEON_VFPV4=y
BR2_CCACHE=y
BR2_PACKAGE_HOST_LINUX_HEADERS_CUSTOM_4_14=y
BR2_INIT_SYSV=y
BR2_TOOLCHAIN_BUILDROOT_GLIBC=y
BR2_TOOLCHAIN_BUILDROOT_CXX=y
BR2_PACKAGE_BINUTILS_TARGET=y
BR2_BINUTILS_VERSION_2_28_1=y
BR2_GCC_VERSION_8_X=y
BR2_ROOTFS_DEVICE_CREATION_DYNAMIC_EUDEV=y
BR2_TARGET_GENERIC_HOSTNAME="RutokenM2M"
BR2_TARGET_GENERIC_ROOT_PASSWD="root"
BR2_ROOTFS_USERS_TABLES="board/rutoken/rutoken-4990-rpi2/users"
BR2_TARGET_GENERIC_ISSUE="Please login to see information about m2m demo board"
BR2_SYSTEM_DHCP="eth0"
BR2_TARGET_TZ_INFO=y
BR2_TARGET_LOCALTIME="Turkey"
BR2_ROOTFS_OVERLAY="board/rutoken/rutoken-4990-rpi2/rootfs_overlay"
BR2_ROOTFS_POST_BUILD_SCRIPT="board/raspberrypi2/post-build.sh"
BR2_ROOTFS_POST_IMAGE_SCRIPT="board/rutoken/rutoken-4990-rpi2/post-image.sh"
BR2_LINUX_KERNEL=y
BR2_LINUX_KERNEL_CUSTOM_TARBALL=y
BR2_LINUX_KERNEL_CUSTOM_TARBALL_LOCATION="$(call github,raspberrypi,linux,83b36f98e1a48d143f0b466fcf9f8c4e382c9a1c)/linux-83b36f98e1a48d143f0b466fcf9f8c4e382c9a1c.tar.gz"
BR2_LINUX_KERNEL_DEFCONFIG="bcm2709"
BR2_LINUX_KERNEL_DTS_SUPPORT=y
BR2_LINUX_KERNEL_INTREE_DTS_NAME="bcm2709-rpi-2-b"
BR2_LINUX_KERNEL_DTS_OVERLAYS_SUPPORT=y
BR2_PACKAGE_RPI_FIRMWARE=y
BR2_PACKAGE_PYTHON3=y
BR2_PACKAGE_OPENSSH=y
BR2_PACKAGE_BASH=y
BR2_PACKAGE_NANO=y
BR2_PACKAGE_NANO_TINY=y
BR2_PACKAGE_SUDO=y
BR2_PACKAGE_START_STOP_DAEMON=y
BR2_PACKAGE_FILE=y
BR2_PACKAGE_SYSKLOGD=y
BR2_PACKAGE_COREUTILS=y
BR2_PACKAGE_UTIL_LINUX_BINARIES=y
BR2_PACKAGE_LIBTOOL=y
BR2_PACKAGE_READLINE=y
BR2_PACKAGE_OPENSC=y
BR2_PACKAGE_STATSERIAL=y
BR2_PACKAGE_SETSERIAL=y
BR2_PACKAGE_WIRINGPI=y
BR2_PACKAGE_LIBXSLT=y
BR2_PACKAGE_PROCPS_NG=y
BR2_PACKAGE_PCSC_TOOLS=y
BR2_PACKAGE_PCSC_LITE_FORCE_LIBUSB=y
BR2_PACKAGE_PCSC_LITE_EMBEDDED=y
BR2_PACKAGE_PCSC_LITE_DEBUGATR=y
BR2_PACKAGE_CCID=y
BR2_PACKAGE_OPENSSL=y
BR2_PACKAGE_LIBOPENSSL=y
BR2_PACKAGE_LIBOPENSSL_BIN=y
BR2_TARGET_ROOTFS_EXT2=y
BR2_TARGET_ROOTFS_EXT2_4=y
BR2_TARGET_ROOTFS_EXT2_SIZE="1966080"
BR2_PACKAGE_HOST_DOSFSTOOLS=y
BR2_PACKAGE_HOST_GENIMAGE=y
BR2_PACKAGE_HOST_MTOOLS=y


# Optional packages for debugging and usage
# uncomment if need one
#
# BR2_PACKAGE_PYTHON3_SQLITE=y
# BR2_PACKAGE_PYTHON_RPI_GPIO=y
# BR2_PACKAGE_PYTHON_SERIAL=y
# BR2_PACKAGE_PYTHON_SPIDEV=y
# BR2_PACKAGE_STRACE=y
# BR2_PACKAGE_LTRACE=y
# BR2_SHARED_STATIC_LIBS=y
# BR2_BINFMT_SUPPORTS_SHARED=y
# BR2_PACKAGE_RSYSLOG=y
# BR2_ENABLE_DEBUG=y
# BR2_DEBUG_3=y
# BR2_PACKAGE_GDB_ARCH_SUPPORTS=y
# BR2_PACKAGE_GDB=y
# BR2_PACKAGE_GDB_SERVER=y
# BR2_PACKAGE_GDB_DEBUGGER=y
# BR2_PACKAGE_GDB_TUI=y
# BR2_PACKAGE_DTC=y
# BR2_PACKAGE_DTC_PROGRAMS=y
# BR2_PACKAGE_I2C_TOOLS=y
# BR2_PACKAGE_LIBSERIAL=y
# BR2_PACKAGE_LIBSERIALPORT=y
# BR2_PACKAGE_LIBGPIOD=y
# BR2_PACKAGE_LIBGPIOD_TOOLS=y
# BR2_PACKAGE_PERL=y
# BR2_PACKAGE_PERL_MODULES=""
# BR2_PACKAGE_PERL_TIMEDATE=y
# BR2_PACKAGE_PERL_DATETIME_TINY=y
# BR2_PACKAGE_PERL_DEVICE_SERIALPORT=y
```

## package/rutoken-m2m-sdk/Config.in
```kconfig
menu "Rutoken M2M SDK"

	source "package/rutoken-m2m-sdk/pcsc-tools/Config.in"
	source "package/rutoken-m2m-sdk/opensc/Config.in"
	source "package/rutoken-m2m-sdk/rutoken-m2m-utils/Config.in"
	source "package/rutoken-m2m-sdk/rtuart/Config.in"
	source "package/rutoken-m2m-sdk/rutoken-sdk-pkcs11-samples/Config.in"
	source "package/rutoken-m2m-sdk/rutoken-sdk-rtengine-samples/Config.in"

endmenu
```

## package/rutoken-m2m-sdk/m2m-utils/Config.in
```kconfig
config BR2_PACKAGE_RUTOKEN_M2M_UTILS
		bool "M2M Utilities"
		help
			Rutoken scripts for interact with M2M demo board
			
			Following scripts are included in this package:
				rt-control    - system logging and board devices control
				rt-run-sample - samples logging and configuration
				rt-uart-test  - Rutoken 4010 driver Transport API test
```

## package/rutoken-m2m-sdk/opensc/Config.in
```kconfig
config BR2_PACKAGE_OPENSC
		bool "OpenSC Project"
		help
			OpenSC tools

			https://github.com/OpenSC/OpenSC
```

## package/rutoken-m2m-sdk/pcsc-tools/Config.in
```kconfig
config BR2_PACKAGE_PCSC_TOOLS
		bool "pcsc-tools"
                help
                        These tools are used to test a PC/SC driver, card or reader or send commands in a friendly environment

                        http://ludovic.rousseau.free.fr/softwares/pcsc-tools/
```

## package/rutoken-m2m-sdk/rtuart/Config.in
```kconfig
config BR2_PACKAGE_RTUART
		bool "rtuart"
		help
			PC/SC driver for Rutoken 4010 smartcard
			
			Includes rtuart_transport_test -- low-level communication protocol test
			
			For more information about Rutoken M2M board modules see:
				https://www.rutoken.ru/products/all/rutoken-m2m/
```

## package/rutoken-m2m-sdk/rtuartscreader/Config.in
```kconfig
config BR2_PACKAGE_RTUARTSCREADER
		bool "rtuartscreader"
		help
			PC/SC driver for direct access to Rutoken 2151 & Rutoken2100 smartcards
			using UART tranceiver and GPIO pins
			
			For more information about Rutoken M2M board modules see:
				https://www.rutoken.ru/products/all/rutoken-m2m/
```

## package/rutoken-m2m-sdk/rutoken-sdk-pkcs11-samples/Config.in
```kconfig
config BR2_PACKAGE_RUTOKEN_SDK_PKCS11_SAMPLES
		bool "Rutoken SDK PKCS#11 samples"
		help
			Samples of interacting with Rutoken smartcards using PKCS#11
			from Rutoken SDK  
			
			For more infromation see:
				https://www.rutoken.ru/developers/sdk/
```

## package/rutoken-m2m-sdk/rutoken-sdk-rtengine-samples/Config.in
```kconfig
config BR2_PACKAGE_RUTOKEN_SDK_RTENGINE_SAMPLES 
		bool "Rutoken SDK rtengine samples"
		help
			Samples from Rutoken SDK of interacting with Rutoken smartcards
			using OpenSSL API and rtengine
			
			For more infromation see:
				https://www.rutoken.ru/developers/sdk/
```
